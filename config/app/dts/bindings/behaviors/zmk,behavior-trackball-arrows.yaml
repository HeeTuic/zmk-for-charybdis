## config/app/dts/bindings/behaviors/zmk,behavior-trackball-arrows.yaml
```yaml
# zmk,behavior-trackball-arrows.yaml
description: Trackball Arrows behavior
compatible: "zmk,behavior-trackball-arrows"
include: zero_param.yaml

properties:
  "#sensor-binding-cells":
    const: 0
```

## config/boards/shields/charybdis/Kconfig.defconfig
```kconfig
if SHIELD_CHARYBDIS_LEFT

config ZMK_KEYBOARD_NAME
	default "Charybdis"

config ZMK_SPLIT_ROLE_CENTRAL
	default y

endif

if SHIELD_CHARYBDIS_RIGHT

config ZMK_KEYBOARD_NAME
	default "Charybdis"

endif

if SHIELD_CHARYBDIS_LEFT || SHIELD_CHARYBDIS_RIGHT

config ZMK_SPLIT
	default y
	
if LVGL

config LV_Z_VDB_SIZE
	default 64

config LV_Z_DPI
	default 148

config LV_Z_BITS_PER_PIXEL
	default 1

choice LV_COLOR_DEPTH
	default LV_COLOR_DEPTH_1
endchoice

endif # LVGL

endif
```

## config/boards/shields/charybdis_zmk/Kconfig.shield
```kconfig
config SHIELD_CHARYBDIS_ZMK_LEFT
    def_bool $(shields_list_contains,charybdis_zmk_left)

config SHIELD_CHARYBDIS_ZMK_RIGHT
    def_bool $(shields_list_contains,charybdis_zmk_right)
```

## config/config/boards/shields /charybdis/Kconfig.defconfig
```kconfig
if SHIELD_CHARYBDIS_NANO_RIGHT

config ZMK_KEYBOARD_NAME
	default "Charybdis"

config ZMK_SPLIT_BLE_ROLE_CENTRAL
	default y

endif

if SHIELD_CHARYBDIS_LEFT || SHIELD_CHARYBDIS_RIGHT

config ZMK_SPLIT
	default y
	
endif

config MOUSE_LAYER_INDEX
	int "Index of mouse layer"
	default 4

config SCROLL_LAYER_INDEX
	int "Index of scroll layer"
	default 5

config MOUSE_LAYER_ACTIVE_MS
	int "Amount of milliseconds the mouse layer will be active after using the trackball"
	default 400
```

## config/config/boards/shields /charybdis/Kconfig.shield
```kconfig
config SHIELD_CHARYBDIS_ZMK_LEFT
    def_bool $(shields_list_contains,charybdis_ZMK_left)

config SHIELD_CHARYBDIS_ZMK_RIGHT
    def_bool $(shields_list_contains,charybdis_ZMK_right)
```

## west.yml
```yaml
manifest:
  remotes:
    - name: zmkfirmware
      url-base: https://github.com/petejohanson
    - name: inorichi
      url-base: https://github.com/semtexfromua
    # Додавання підтримки nice OLED
    - name: mctechnology17
      url-base: https://github.com/mctechnology17
  projects:
    - name: zmk
      remote: zmkfirmware
      revision: feat/pointers-move-scroll
      import: app/west.yml
    - name: zmk-pmw3610-driver_mod
      remote: inorichi
      revision: main
    # Додавання nice OLED модуля
    - name: zmk-nice-oled
      remote: mctechnology17
      revision: main
  self:
    path: config
```
