## config/west.yml
```yaml
manifest:
  defaults:
    remote: cormoran      # NEW
    revision: main
  remotes:
    - name: cormoran      # NEW
      url-base: https://github.com/cormoran
    - name: zmkfirmware
      url-base: https://github.com/zmkfirmware
    - name: DoctorWangWang
      url-base: https://github.com/DoctorWangWang
  projects:
    - name: zmk
      import:
        file: app/west.yml
      clone-depth: 1
      remote: cormoran    # CHANGE: point to cormoran's fork
      revision: main+dya  # CHANGE: use DYA-enabled branch
    - name: zephyr
      remote: zmkfirmware  # Zephyr stays at zmkfirmware
      revision: v4.1.0+zmk-fixes
      clone-depth: 1
    - name: zmk-pmw3610-driver
      remote: DoctorWangWang
      revision: main
      
  self:
    path: config
```
